## sources/meta-de10-nano/conf/layer.conf
```bitbake
# We have a conf and classes directory, add to BBPATH
BBPATH .= ":${LAYERDIR}"

# We have recipes-* directories, add to BBFILES
BBFILES += "${LAYERDIR}/recipes-*/*/*.bb \
            ${LAYERDIR}/recipes-*/*/*.bbappend"

BBFILE_COLLECTIONS += "de10-nano"
BBFILE_PATTERN_de10-nano = "^${LAYERDIR}/"
BBFILE_PRIORITY_de10-nano = "50"
LAYERVERSION_de10-nano = "4"
LAYERSERIES_COMPAT_de10-nano = "scarthgap"

UBOOT_EXTLINUX_ROOT:default = "root=/dev/mmcblk0p3"

MACHINE_FEATURES:cyclone5 += " usbgadget"

IMAGE_BOOT_FILES = " \
    socfpga_cyclone5_de10_nano_soc.dtb \
	${KERNEL_IMAGETYPE} \
	extlinux.conf;extlinux/extlinux.conf \
"
```
